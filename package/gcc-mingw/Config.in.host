## package/gcc-mingw/Config.in.host
```kconfig
config BR2_PACKAGE_HOST_GCC_ALL_MINGW
	bool "host gcc mingw to target"
	help
	  Build GCC toolchain to the target platform
	  from Windows (MinGW-w64) host
```

## package/gcc-to-mingw/Config.in.host
```kconfig
config BR2_PACKAGE_HOST_GCC_MINGW_TO_MINGW_ALL
	bool "host gcc mingw to mingw"
	help
	  Build GCC toolchain for simulator usage
	  from and to Windows (MinGW-w64) host 
```

## package/ninja-mingw/Config.in.host
```kconfig
config BR2_PACKAGE_NINJA_MINGW
	bool "host (mingw) ninja"
	help
	  Build ninja tool for MinGW-w64 GCC toolchain
```

## package/zlib-ng-mingw/Config.in.host
```kconfig
config BR2_PACKAGE_ZLIB_NG_MINGW
	bool "host (mingw) zlib-ng"
	help
	  Build zlib-ng library for MinGW-w64 GCC toolchain.
	  Necessary for toolchain to be used under CLion IDE
```
